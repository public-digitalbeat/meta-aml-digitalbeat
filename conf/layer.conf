## conf/layer.conf
```bitbake
#We have a conf and classes directory, add to BBPATH
BBPATH .= ":${LAYERDIR}"

#We have a recipes-* directories, add to BBFILES
BBFILES += "${LAYERDIR}/recipes-*/*/*.bb ${LAYERDIR}/recipes-*/*/*.bbappend"

BBFILE_COLLECTIONS += "aml-sei"
BBFILE_PATTERN_aml-sei := "^${LAYERDIR}/"
BBFILE_PRIORITY_aml-sei = "10"
LAYERSERIES_COMPAT_aml-sei = "dunfell"

# license directories.
LICENSE_PATH += "${LAYERDIR}/license"
```
